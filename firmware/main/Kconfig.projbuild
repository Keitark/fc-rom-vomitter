## firmware/main/Kconfig.projbuild
```kconfig
menu "ROM Vomitter FC"

config NESCART_AP_PASSWORD
    string "SoftAP password"
    default "vomit-roms"
    help
        WPA2 password for the cartridge upload access point.

config NESCART_AP_CHANNEL
    int "SoftAP channel"
    range 1 13
    default 6

config NESCART_WIFI_TX_POWER_QDBM
    int "Maximum Wi-Fi TX power in quarter-dBm"
    range 8 80
    default 44
    help
        44 means 11 dBm. Keep this conservative until console-rail and
        regulator thermal measurements are complete.

config NESCART_USB_UPLOAD_ENABLE
    bool "Enable native USB-C ROM upload"
    default y
    help
        Accept framed binary iNES uploads over the ESP32-S3 USB Serial/JTAG
        interface routed to the board's USB-C connector.

config NESCART_USB_UPLOAD_TIMEOUT_MS
    int "USB upload frame timeout in milliseconds"
    depends on NESCART_USB_UPLOAD_ENABLE
    range 1000 60000
    default 15000

config NESCART_CLOUD_PULL_ENABLE
    bool "Enable HTTPS cloud ROM polling"
    default n
    select MBEDTLS_CERTIFICATE_BUNDLE
    help
        Keep the recovery SoftAP active and also join a Wi-Fi network to poll
        a fixed ROM URL or the operator-controlled exhibition queue.
        Credentials remain in the local sdkconfig and must not be committed.

if NESCART_CLOUD_PULL_ENABLE

config NESCART_CLOUD_QUEUE_ENABLE
    bool "Use operator-controlled exhibition queue instead of a fixed ROM URL"
    default n
    help
        Sign protocol-v2 requests to the Cloudflare service. No visitor upload
        reaches the cartridge until the operator releases one queue entry.

config NESCART_CLOUD_STA_SSID
    string "Cloud Wi-Fi SSID"

config NESCART_CLOUD_STA_PASSWORD
    string "Cloud Wi-Fi password"

config NESCART_CLOUD_ROM_URL
    string "HTTPS URL returning the raw iNES file"
    depends on !NESCART_CLOUD_QUEUE_ENABLE

config NESCART_CLOUD_BEARER_TOKEN
    string "Optional bearer token"
    default ""
    depends on !NESCART_CLOUD_QUEUE_ENABLE

config NESCART_CLOUD_SERVICE_ORIGIN
    string "Exhibition service HTTPS origin (no path or trailing slash)"
    depends on NESCART_CLOUD_QUEUE_ENABLE

config NESCART_CLOUD_DEVICE_ID
    string "Exhibition device identifier"
    depends on NESCART_CLOUD_QUEUE_ENABLE

config NESCART_CLOUD_DEVICE_HMAC_SECRET
    string "Exhibition device HMAC secret (never commit a real value)"
    depends on NESCART_CLOUD_QUEUE_ENABLE

config NESCART_CLOUD_POLL_SECONDS
    int "Cloud polling interval in seconds"
    range 2 86400
    default 60

config NESCART_CLOUD_HTTP_TIMEOUT_MS
    int "Cloud request timeout in milliseconds"
    range 1000 60000
    default 10000

config NESCART_CLOUD_ALLOW_CONSOLE_RELOAD
    bool "Allow operator-dispatched update to interrupt a powered console"
    default n
    help
        On the FC board this isolates the cartridge bus, updates and verifies
        SRAM, then requires the operator to press Famicom RESET. Enable only
        after real-board bus and power tests. A fixed-URL pull will also use
        this permission, so prefer the queue mode for exhibition use.

config NESCART_CLOUD_ALLOW_INSECURE_HTTP
    bool "Allow plain HTTP for isolated development only"
    default n

endif

config NESCART_CONSOLE_ADC_THRESHOLD
    int "Raw ADC threshold for console 5 V present"
    range 100 4000
    default 1000

endmenu
```
